## experiments/zenoh/sdkconfig.defaults
```kconfig
# zenoh-pico's z_open + session setup overflow the 3584-byte default main stack.
CONFIG_ESP_MAIN_TASK_STACK_SIZE=16384
# Headroom for the TCP/IP + zenoh read/lease tasks under load.
CONFIG_ESP_SYSTEM_EVENT_TASK_STACK_SIZE=4096
```

## sdkconfig.defaults
```kconfig
# Unified image: the robot role needs little, the HUB ROLE needs the rest.
# (The hub role's broker/NAT/WS-bridge config, folded in 2026-07-09.)

# mosq_broker_run() blocks in the main task and Mosquitto wants >=5KB stack; the
# robot role runs in the same task and is happy with the headroom.
CONFIG_ESP_MAIN_TASK_STACK_SIZE=10240

# NAT: the hub role forwards AP-side traffic out the STA uplink (built into
# ESP-IDF lwIP). Without these, a device joining the hub's AP is a dead-end island.
CONFIG_LWIP_IP_FORWARD=y
CONFIG_LWIP_IPV4_NAPT=y

# WebSocket server support for the hub role's WS<->TCP bridge (browser MQTT-over-WS).
CONFIG_HTTPD_WS_SUPPORT=y

# Socket pool. The mosquitto-era budget (3 sockets per browser session: WS +
# broker TCP + the broker's accepted end) died with the Zenoh cutover — a WS
# session now costs ONE socket, but the hub's zenoh peer-listener accepts a
# TCP connection per robot. Full classroom peak: 8 robots + 6 WS dashboards
# (ws_zenoh_bridge MAX_CLIENTS) + 6 :80 page sockets (wifi_portal) + the
# ~6-listener baseline (two httpds, zenoh :7447, DNS forwarder, mDNS, uplink
# probe; the camera board adds one more httpd) ≈ 27. 16 once let three
# sessions' churn exhaust the pool and wedge every listener until reboot —
# the failure this ceiling exists to keep far away.
CONFIG_LWIP_MAX_SOCKETS=32

# Serving the ~117 KB gzipped dashboard was capped by lwIP's stock windows,
# not the radio: SND_BUF/WND at the 5760 default keep only 4 MSS-sized
# segments in flight, ~0.3-0.6 MB/s at Wi-Fi RTTs — seconds per page load
# while the link idles. 16×MSS send / 8×MSS receive lifts the in-flight cap
# where it binds (the chip mostly SENDS pages; receive matters for OTA push).
# Cost is heap, per busy socket, allocated on demand — a page load can hold
# ~17 KB of send buffer while in flight, which the hub's ~6 concurrent-HTTP
# worst case affords. RECVMBOX is pointer-sized per entry; 6 dropped bursts
# on the floor (each drop a retransmit round-trip).
CONFIG_LWIP_TCP_SND_BUF_DEFAULT=23040
CONFIG_LWIP_TCP_WND_DEFAULT=11520
CONFIG_LWIP_TCP_RECVMBOX_SIZE=16

# Hot lwIP paths in IRAM: ~10% more TCP throughput for ~13 KB of IRAM.
# Cheap next to the buffer bump above, but it is the first thing to drop if a
# board's IRAM segment ever overflows at link.
CONFIG_LWIP_IRAM_OPTIMIZATION=y

# 4 MB flash. The real table is partitions.csv (ota_0 + ota_1), passed by
# platformio.ini's board_build.partitions — PlatformIO generates partitions.bin
# from THAT and flashes it, so the symbol below is only idf.py's fallback and
# does not describe what is on the chip. Verified by decoding the built
# partitions.bin, not by reading this file.
CONFIG_ESPTOOLPY_FLASHSIZE_4MB=y
CONFIG_PARTITION_TABLE_SINGLE_APP_LARGE=y

# A/B rollback. The bootloader boots a freshly-OTA'd app as PENDING_VERIFY; if
# the app does not call esp_ota_mark_app_valid_cancel_rollback() before the next
# reboot, the bootloader reverts to the other slot. A panic, a WDT reset or a
# power cut during that first boot therefore self-heals with no USB trip — which
# is the entire reason for the two-slot layout. ota_update.c owns the mark call.
CONFIG_BOOTLOADER_APP_ROLLBACK_ENABLE=y

# The app built at -Og (ESP-IDF's default) while the bootloader beside it was
# already size-optimized — nothing chose that asymmetry, it was just the default
# nobody looked at. Measured 2026-07-16: esp32dev/robot-l298n -70,576 B,
# esp32c3-supermini -121,936 B, esp32cam -143,296 B.
#
# This buys nothing against the 3 MB factory partition alone (the largest image
# uses 63% of it). It is here for the A/B OTA layout, where the image must fit
# a slot half that size, and for the AP radio: OTA pushes the whole image over
# the one radio a classroom already shares.
#
# The cost is real: inlining and reordering make a panic backtrace harder to map
# to a line, on boards students debug. Accepted because flash is the binding
# constraint and the serial exception decoder still resolves addresses.
CONFIG_COMPILER_OPTIMIZATION_SIZE=y
```

## sdkconfig.defaults.esp32
```kconfig
# Applied to every esp32-TARGET build (esp32cam, esp32dev, robot-l298n). IDF loads
# sdkconfig.defaults.<target> after sdkconfig.defaults — the native way to carry a
# per-target override, since PlatformIO merges only ONE sdkconfig.defaults and the
# generated per-env sdkconfig.* files are gitignored (so a hand edit there wouldn't
# survive a checkout). This is how the esp32cam gets PSRAM durably: the OV3660 frame
# buffers live in the 4 MB PSRAM (camera.c → CAMERA_FB_IN_PSRAM). A bare ESP32 with
# no PSRAM chip boots fine via IGNORE_NOTFOUND (the support code is simply inert).
# The C3 is a different target and is untouched.
CONFIG_SPIRAM=y
CONFIG_SPIRAM_IGNORE_NOTFOUND=y
CONFIG_SPIRAM_USE_MALLOC=y

# Run the classic ESP32 at its full 240 MHz (board default is 160). The hub role
# — zenoh executor + WS-JSON bridge + per-sample cJSON fan-out — is the heaviest
# workload on these boards, and 240 buys ~50% more headroom for it and the drive
# loop. Costs more power/heat, acceptable for a bench/classroom robot on USB or a
# pack. The C3 is a different target (maxes at 160) and never reads this file.
CONFIG_ESP_DEFAULT_CPU_FREQ_MHZ_240=y
CONFIG_ESP_DEFAULT_CPU_FREQ_MHZ=240
```

## sdkconfig.defaults.esp32s3
```kconfig
# Applied to every esp32s3-TARGET build (esp32s3cam). IDF loads
# sdkconfig.defaults.<target> AFTER sdkconfig.defaults — same per-target mechanism
# sdkconfig.defaults.esp32 uses; see that file's header for why the generated
# per-env sdkconfig.* can't carry this durably. The C3/classic targets never read
# this file.

# 8 MB flash. Overrides the 4 MB fallback in sdkconfig.defaults (a choice symbol:
# the later =y wins). partitions.csv is still the real table — this is idf.py's
# fallback and the size esptool stamps in the image header / probes on the chip.
CONFIG_ESPTOOLPY_FLASHSIZE_8MB=y

# Octal (OPI) PSRAM — the N8R8 module's 8 MB SPIRAM, where the camera frame buffers
# live (camera.c -> CAMERA_FB_IN_PSRAM). Unlike the classic ESP32 rev with the cache
# workaround, the S3 DMAs straight into PSRAM, so there is no non-DMA line-buffer
# ceiling on frame size here. IGNORE_NOTFOUND keeps a board with a dead PSRAM chip
# booting (camera.c then falls back to internal RAM for QVGA).
CONFIG_SPIRAM=y
CONFIG_SPIRAM_MODE_OCT=y
CONFIG_SPIRAM_SPEED_80M=y
CONFIG_SPIRAM_USE_MALLOC=y
CONFIG_SPIRAM_IGNORE_NOTFOUND=y

# Full 240 MHz — same reasoning as sdkconfig.defaults.esp32: the hub role (zenoh
# executor + WS-JSON bridge + per-sample cJSON fan-out) is the heavy workload, and
# the S3 tops out at 240.
CONFIG_ESP_DEFAULT_CPU_FREQ_MHZ_240=y
CONFIG_ESP_DEFAULT_CPU_FREQ_MHZ=240
```
